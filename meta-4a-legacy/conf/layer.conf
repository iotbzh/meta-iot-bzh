## meta-4a-legacy/conf/layer.conf
```bitbake
# We have a conf and classes directory, add to BBPATH
BBPATH .= ":${LAYERDIR}"

# We have recipes-* directories, add to BBFILES
BBFILES += "${LAYERDIR}/recipes-*/*/*.bb \
    ${LAYERDIR}/recipes-*/*/*.bbappend"

BBFILE_COLLECTIONS += "iotbzh-4a-legacy"
BBFILE_PATTERN_iotbzh-4a-legacy = "^${LAYERDIR}/"
BBFILE_PRIORITY_iotbzh-4a-legacy = "100"
```

## meta-agl-devkit/conf/layer.conf
```bitbake
# We have a conf and classes directory, add to BBPATH
BBPATH .= ":${LAYERDIR}"

# We have recipes-* directories, add to BBFILES
BBFILES += "${LAYERDIR}/recipes-*/*/*.bb \
	${LAYERDIR}/recipes-*/*/*.bbappend"

BBFILE_COLLECTIONS += "agl-devkit"
BBFILE_PATTERN_agl-devkit = "^${LAYERDIR}/"
BBFILE_PRIORITY_agl-devkit = "20"

# extra packages to install into the SDK for target
TOOLCHAIN_TARGET_TASK += "lua-staticdev"
```

## meta-agl-early/conf/layer.conf
```bitbake
# We have a conf and classes directory, add to BBPATH
BBPATH .= ":${LAYERDIR}"

# We have recipes-* directories, add to BBFILES
BBFILES += "${LAYERDIR}/recipes-*/*/*.bb \
    ${LAYERDIR}/recipes-*/*/*.bbappend"

BBFILE_COLLECTIONS += "agl-early"
BBFILE_PATTERN_agl-early = "^${LAYERDIR}/"
BBFILE_PRIORITY_agl-early = "7"

########### 4A HAL configuration for Green Box #############

4A_RUNTIME_HAL = "2ch-generic-usb"
4A_RUNTIME_HAL_m3ulcb = "greenbox"
4A_RUNTIME_HAL_h3ulcb = "greenbox"
4A_RUNTIME_HAL_intel-corei7-64 = "intel-minnow intel-upsquared-hdmi"
4A_RUNTIME_HAL_qemux86-64 = "intel-qemu"
```

## meta-app-framework/conf/layer.conf
```bitbake
# We have a conf and classes directory, add to BBPATH
BBPATH .= ":${LAYERDIR}"

# We have recipes-* directories, add to BBFILES
BBFILES += "${LAYERDIR}/recipes-*/*/*.bb \
	${LAYERDIR}/recipes-*/*/*.bbappend"

BBFILE_COLLECTIONS += "iot-app-framework"
BBFILE_PATTERN_iot-app-framework = "^${LAYERDIR}/"
BBFILE_PRIORITY_iot-app-framework = "20"
```

## meta-baragwin/conf/layer.conf
```bitbake
# We have a conf and classes directory, add to BBPATH
BBPATH .= ":${LAYERDIR}"

# We have recipes-* directories, add to BBFILES
BBFILES += "${LAYERDIR}/recipes-*/*/*.bb \
    ${LAYERDIR}/recipes-*/*/*.bbappend"

#BBFILE_COLLECTIONS += "iotbzh-baragwin"
#BBFILE_PATTERN_iotbzh-baragwin = "^${LAYERDIR}/"
#BBFILE_PRIORITY_iotbzh-baragwin = "120"

#LAYERSERIES_COMPAT_iotbzh-baragwin = "thud"
```

## meta-connectivity/conf/layer.conf
```bitbake
# We have a conf and classes directory, add to BBPATH
BBPATH .= ":${LAYERDIR}"

# We have recipes-* directories, add to BBFILES
BBFILES += "${LAYERDIR}/recipes-*/*/*.bb \
	${LAYERDIR}/recipes-*/*/*.bbappend"

BBFILE_COLLECTIONS += "iotbzh-connectivity"
BBFILE_PATTERN_iotbzh-connectivity = "^${LAYERDIR}/"
BBFILE_PRIORITY_iotbzh-connectivity = "20"
```

## meta-custom/conf/layer.conf
```bitbake
# We have a conf and classes directory, add to BBPATH
BBPATH .= ":${LAYERDIR}"
BBPATH .= ":${LAYERDIR}/recipes-monitoring"

# add recipes based on existing layers set in BBFILE_COLLECTIONS
BBFILES += "${@' '.join('${LAYERDIR}/cond-recipes-*/%s/*/*.bb' % layer \
               for layer in BBFILE_COLLECTIONS.split())}"
BBFILES += "${@' '.join('${LAYERDIR}/cond-recipes-*/%s/*/*.bbppend' % layer \
               for layer in BBFILE_COLLECTIONS.split())}"
# or we prepend it with meta-  (e.g. rpi, fsl*)
BBFILES += "${@' '.join('${LAYERDIR}/cond-recipes-*/meta-%s/*/*.bb' % layer \
               for layer in BBFILE_COLLECTIONS.split())}"
BBFILES += "${@' '.join('${LAYERDIR}/cond-recipes-*/meta-%s/*/*.bbappend' % layer \
               for layer in BBFILE_COLLECTIONS.split())}"

# We have recipes-* directories, add to BBFILES
BBFILES += "${LAYERDIR}/recipes-*/*/*.bb \
    ${LAYERDIR}/recipes-*/*/*.bbappend"

BBFILE_COLLECTIONS += "iotbzh-custom"
BBFILE_PATTERN_iotbzh-custom = "^${LAYERDIR}/"
BBFILE_PRIORITY_iotbzh-custom = "100"

LAYERSERIES_COMPAT_iotbzh-custom = "thud"

# extra userdata definition needed by monitoring recipes
require ${LAYERDIR}/recipes-monitoring/layer.conf.inc

# remove useless tarball images
IMAGE_FSTYPES_remove = "tar.xz"
IMAGE_FSTYPES_remove = "tar.bz2"
IMAGE_FSTYPES_remove = "tar.gz"
```

## meta-extra-apps/conf/layer.conf
```bitbake
# We have a conf and classes directory, add to BBPATH
BBPATH .= ":${LAYERDIR}"

# We have recipes-* directories, add to BBFILES
BBFILES += "${LAYERDIR}/recipes-*/*/*.bb \
	${LAYERDIR}/recipes-*/*/*.bbappend"

BBFILE_COLLECTIONS += "iotbzh-extra-apps"
BBFILE_PATTERN_iotbzh-extra-apps = "^${LAYERDIR}/"
BBFILE_PRIORITY_iotbzh-extra-apps = "110"

LAYERSERIES_COMPAT_iotbzh-extra-apps = "zeus"
```

## meta-installer/conf/layer.conf
```bitbake
# We have a conf and classes directory, add to BBPATH
BBPATH .= ":${LAYERDIR}"

# add recipes based on existing layers set in BBFILE_COLLECTIONS
BBFILES += "${@' '.join('${LAYERDIR}/cond-recipes-*/%s/*/*.bb' % layer \
               for layer in BBFILE_COLLECTIONS.split())}"
BBFILES += "${@' '.join('${LAYERDIR}/cond-recipes-*/%s/*/*.bbappend' % layer \
               for layer in BBFILE_COLLECTIONS.split())}"
# or we prepend it with meta-  (e.g. rpi, fsl*)
BBFILES += "${@' '.join('${LAYERDIR}/cond-recipes-*/meta-%s/*/*.bb' % layer \
               for layer in BBFILE_COLLECTIONS.split())}"
BBFILES += "${@' '.join('${LAYERDIR}/cond-recipes-*/meta-%s/*/*.bbappend' % layer \
               for layer in BBFILE_COLLECTIONS.split())}"

# We have recipes-* directories, add to BBFILES
BBFILES += "${LAYERDIR}/recipes-*/*/*.bb \
    ${LAYERDIR}/recipes-*/*/*.bbappend"

BBFILE_COLLECTIONS += "iotbzh-installer"
BBFILE_PATTERN_iotbzh-installer = "^${LAYERDIR}/"
BBFILE_PRIORITY_iotbzh-installer= "100"

LAYERSERIES_COMPAT_iotbzh-installer = "dunfell"
```

## meta-netboot/conf/layer.conf
```bitbake
# We have a conf and classes directory, add to BBPATH
BBPATH .= ":${LAYERDIR}"

# We have recipes-* directories, add to BBFILES
BBFILES += "${LAYERDIR}/recipes-*/*/*.bb \
	${LAYERDIR}/recipes-*/*/*.bbappend"

BBFILE_COLLECTIONS += "meta-netboot"
BBFILE_PATTERN_meta-netboot = "^${LAYERDIR}/"
BBFILE_PRIORITY_meta-netboot = "20"

##################################################################
# add initrd image and add new format for rootfs to enable NBD sharing
IMAGE_FSTYPES += "ext4"
INITRAMFS_IMAGE += "initramfs-netboot-image"

# specific initrd format for U-boot based images
IMAGE_CLASSES += "${@'image_types_uboot' if (d.getVar("KERNEL_IMAGETYPE", True) == "uImage") else ''}"
INITRAMFS_FSTYPES += "${@'ext4.gz.u-boot' if (d.getVar("KERNEL_IMAGETYPE", True) == "uImage") else 'ext4.gz'}"
```

## meta-speech/conf/layer.conf
```bitbake
# We have a conf and classes directory, add to BBPATH
BBPATH .= ":${LAYERDIR}"

# We have recipes-* directories, add to BBFILES
BBFILES += "${LAYERDIR}/recipes-*/*/*.bb \
    ${LAYERDIR}/recipes-*/*/*.bbappend"

BBFILE_COLLECTIONS += "iotbzh-speech"
BBFILE_PATTERN_iotbzh-speech = "^${LAYERDIR}/"
BBFILE_PRIORITY_iotbzh-speech = "120"

LAYERSERIES_COMPAT_iotbzh-speech = "dunfell"
```
